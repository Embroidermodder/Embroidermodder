.. |app| image:: _static/images/sphinxdocs/app.png
.. |python| image:: _static/images/sphinxdocs/python.png
.. |methsum| image:: _static/images/sphinxdocs/method_summary.png
.. |methods_summary| replace:: |methsum| **Methods summary**
.. |module_summary| image:: _static/images/sphinxdocs/module_summary.png
.. |__________________________________________________________________________| image:: _static/images/sphinxdocs/gradientline1024.png

.. |Embroidermodder_Screenshot| image:: _static/images/screenies/embroidermodder_screenie.png

.. |br| raw:: html

   <br />

.. .. External Hyperlinks

.. _EmboidermodderBaseURL: http://embroidermodder.github.io/index.html

.. _PySide_1_0_7_API: http://srinikom.github.com/pyside-docs/
.. _PySide_1_1_0_API: https://deptinfo-ensip.univ-poitiers.fr/ENS/pyside-docs/index.html
.. _PySide_1_2_1_API: http://pyside.github.io/docs/pyside/


.. .. QtCore
.. .. A
.. _QAbstractAnimation:             http://pyside.github.io/docs/pyside/PySide/QtCore/QAbstractAnimation.html
.. _QAbstractEventDispatcher:       http://pyside.github.io/docs/pyside/PySide/QtCore/QAbstractEventDispatcher.html
.. _QAbstractFileEngine:            http://pyside.github.io/docs/pyside/PySide/QtCore/QAbstractFileEngine.html
.. _QAbstractFileEngineHandler:     http://pyside.github.io/docs/pyside/PySide/QtCore/QAbstractFileEngineHandler.html
.. _QAbstractFileEngineIterator:    http://pyside.github.io/docs/pyside/PySide/QtCore/QAbstractFileEngineIterator.html
.. _QAbstractItemModel:             http://pyside.github.io/docs/pyside/PySide/QtCore/QAbstractItemModel.html
.. _QAbstractListModel:             http://pyside.github.io/docs/pyside/PySide/QtCore/QAbstractListModel.html
.. _QAbstractState:                 http://pyside.github.io/docs/pyside/PySide/QtCore/QAbstractState.html
.. _QAbstractTableModel:            http://pyside.github.io/docs/pyside/PySide/QtCore/QAbstractTableModel.html
.. _QAbstractTransition:            http://pyside.github.io/docs/pyside/PySide/QtCore/QAbstractTransition.html
.. _QAnimationGroup:                http://pyside.github.io/docs/pyside/PySide/QtCore/QAnimationGroup.html
.. .. B
.. _QBasicTimer:                    http://pyside.github.io/docs/pyside/PySide/QtCore/QBasicTimer.html
.. _QBitArray:                      http://pyside.github.io/docs/pyside/PySide/QtCore/QBitArray.html
.. _QBuffer:                        http://pyside.github.io/docs/pyside/PySide/QtCore/QBuffer.html
.. _QByteArray:                     http://pyside.github.io/docs/pyside/PySide/QtCore/QByteArray.html
.. _QByteArrayMatcher:              http://pyside.github.io/docs/pyside/PySide/QtCore/QByteArrayMatcher.html
.. .. C
.. _QChildEvent:                    http://pyside.github.io/docs/pyside/PySide/QtCore/QChildEvent.html
.. _QCoreApplication:               http://pyside.github.io/docs/pyside/PySide/QtCore/QCoreApplication.html
.. _QCryptographicHash:             http://pyside.github.io/docs/pyside/PySide/QtCore/QCryptographicHash.html
.. .. D
.. _QDataStream:                    http://pyside.github.io/docs/pyside/PySide/QtCore/QDataStream.html
.. _QDate:                          http://pyside.github.io/docs/pyside/PySide/QtCore/QDate.html
.. _QDateTime:                      http://pyside.github.io/docs/pyside/PySide/QtCore/QDateTime.html
.. _QDir:                           http://pyside.github.io/docs/pyside/PySide/QtCore/QDir.html
.. _QDirIterator:                   http://pyside.github.io/docs/pyside/PySide/QtCore/QDirIterator.html
.. _QDynamicPropertyChangeEvent:    http://pyside.github.io/docs/pyside/PySide/QtCore/QDynamicPropertyChangeEvent.html
.. .. E
.. _QEasingCurve:                   http://pyside.github.io/docs/pyside/PySide/QtCore/QEasingCurve.html
.. _QElapsedTimer:                  http://pyside.github.io/docs/pyside/PySide/QtCore/QElapsedTimer.html
.. _QEvent:                         http://pyside.github.io/docs/pyside/PySide/QtCore/QEvent.html
.. _QEventLoop:                     http://pyside.github.io/docs/pyside/PySide/QtCore/QEventLoop.html
.. _QEventTransition:               http://pyside.github.io/docs/pyside/PySide/QtCore/QEventTransition.html
.. .. F
.. _QFSFileEngine:                  http://pyside.github.io/docs/pyside/PySide/QtCore/QFSFileEngine.html
.. _QFactoryInterface:              http://pyside.github.io/docs/pyside/PySide/QtCore/QFactoryInterface.html
.. _QFile:                          http://pyside.github.io/docs/pyside/PySide/QtCore/QFile.html
.. _QFileInfo:                      http://pyside.github.io/docs/pyside/PySide/QtCore/QFileInfo.html
.. _QFileSystemWatcher:             http://pyside.github.io/docs/pyside/PySide/QtCore/QFileSystemWatcher.html
.. _QFinalState:                    http://pyside.github.io/docs/pyside/PySide/QtCore/QFinalState.html
.. .. G
.. _QGenericArgument:               http://pyside.github.io/docs/pyside/PySide/QtCore/QGenericArgument.html
.. _QGenericReturnArgument:         http://pyside.github.io/docs/pyside/PySide/QtCore/QGenericReturnArgument.html
.. .. H
.. _QHistoryState:                  http://pyside.github.io/docs/pyside/PySide/QtCore/QHistoryState.html
.. .. I
.. _QIODevice:                      http://pyside.github.io/docs/pyside/PySide/QtCore/QIODevice.html
.. .. L
.. _QLibraryInfo:                   http://pyside.github.io/docs/pyside/PySide/QtCore/QLibraryInfo.html
.. _QLine:                          http://pyside.github.io/docs/pyside/PySide/QtCore/QLine.html
.. _QLineF:                         http://pyside.github.io/docs/pyside/PySide/QtCore/QLineF.html
.. _QLocale:                        http://pyside.github.io/docs/pyside/PySide/QtCore/QLocale.html
.. .. M
.. _QMargins:                       http://pyside.github.io/docs/pyside/PySide/QtCore/QMargins.html
.. _QMetaClassInfo:                 http://pyside.github.io/docs/pyside/PySide/QtCore/QMetaClassInfo.html
.. _QMetaEnum:                      http://pyside.github.io/docs/pyside/PySide/QtCore/QMetaEnum.html
.. _QMetaMethod:                    http://pyside.github.io/docs/pyside/PySide/QtCore/QMetaMethod.html
.. _QMetaObject:                    http://pyside.github.io/docs/pyside/PySide/QtCore/QMetaObject.html
.. _QMetaProperty:                  http://pyside.github.io/docs/pyside/PySide/QtCore/QMetaProperty.html
.. _QMimeData:                      http://pyside.github.io/docs/pyside/PySide/QtCore/QMimeData.html
.. _QModelIndex:                    http://pyside.github.io/docs/pyside/PySide/QtCore/QModelIndex.html
.. _QMutex:                         http://pyside.github.io/docs/pyside/PySide/QtCore/QMutex.html
.. _QMutexLocker:                   http://pyside.github.io/docs/pyside/PySide/QtCore/QMutexLocker.html
.. .. O
.. _QObject:                        http://pyside.github.io/docs/pyside/PySide/QtCore/QObject.html
.. .. P
.. _QParallelAnimationGroup:        http://pyside.github.io/docs/pyside/PySide/QtCore/QParallelAnimationGroup.html
.. _QPauseAnimation:                http://pyside.github.io/docs/pyside/PySide/QtCore/QPauseAnimation.html
.. _QPersistentModelIndex:          http://pyside.github.io/docs/pyside/PySide/QtCore/QPersistentModelIndex.html
.. _QPluginLoader:                  http://pyside.github.io/docs/pyside/PySide/QtCore/QPluginLoader.html
.. _QPoint:                         http://pyside.github.io/docs/pyside/PySide/QtCore/QPoint.html
.. _QPointF:                        http://pyside.github.io/docs/pyside/PySide/QtCore/QPointF.html
.. _QProcess:                       http://pyside.github.io/docs/pyside/PySide/QtCore/QProcess.html
.. _QProcessEnvironment:            http://pyside.github.io/docs/pyside/PySide/QtCore/QProcessEnvironment.html
.. _QPropertyAnimation:             http://pyside.github.io/docs/pyside/PySide/QtCore/QPropertyAnimation.html
.. .. R
.. _QReadLocker:                    http://pyside.github.io/docs/pyside/PySide/QtCore/QReadLocker.html
.. _QReadWriteLock:                 http://pyside.github.io/docs/pyside/PySide/QtCore/QReadWriteLock.html
.. _QRect:                          http://pyside.github.io/docs/pyside/PySide/QtCore/QRect.html
.. _QRectF:                         http://pyside.github.io/docs/pyside/PySide/QtCore/QRectF.html
.. _QRegExp:                        http://pyside.github.io/docs/pyside/PySide/QtCore/QRegExp.html
.. _QResource:                      http://pyside.github.io/docs/pyside/PySide/QtCore/QResource.html
.. _QRunnable:                      http://pyside.github.io/docs/pyside/PySide/QtCore/QRunnable.html
.. .. S
.. _ClassInfo:                      http://pyside.github.io/docs/pyside/PySide/QtCore/ClassInfo.html
.. _QSemaphore:                     http://pyside.github.io/docs/pyside/PySide/QtCore/QSemaphore.html
.. _QSequentialAnimationGroup:      http://pyside.github.io/docs/pyside/PySide/QtCore/QSequentialAnimationGroup.html
.. _QSettings:                      http://pyside.github.io/docs/pyside/PySide/QtCore/QSettings.html
.. _QSignalMapper:                  http://pyside.github.io/docs/pyside/PySide/QtCore/QSignalMapper.html
.. _QSignalTransition:              http://pyside.github.io/docs/pyside/PySide/QtCore/QSignalTransition.html
.. _QSize:                          http://pyside.github.io/docs/pyside/PySide/QtCore/QSize.html
.. _QSizeF:                         http://pyside.github.io/docs/pyside/PySide/QtCore/QSizeF.html
.. _QSocketNotifier:                http://pyside.github.io/docs/pyside/PySide/QtCore/QSocketNotifier.html
.. _QState:                         http://pyside.github.io/docs/pyside/PySide/QtCore/QState.html
.. _QStateMachine:                  http://pyside.github.io/docs/pyside/PySide/QtCore/QStateMachine.html
.. _QStateMachine.SignalEvent:      http://pyside.github.io/docs/pyside/PySide/QtCore/QStateMachine.SignalEvent.html
.. _QStateMachine.WrappedEvent:     http://pyside.github.io/docs/pyside/PySide/QtCore/QStateMachine.WrappedEvent.html
.. _QSysInfo:                       http://pyside.github.io/docs/pyside/PySide/QtCore/QSysInfo.html
.. _QSystemLocale:                  http://pyside.github.io/docs/pyside/PySide/QtCore/QSystemLocale.html
.. _QSystemSemaphore:               http://pyside.github.io/docs/pyside/PySide/QtCore/QSystemSemaphore.html
.. _Signal:                         http://pyside.github.io/docs/pyside/PySide/QtCore/Signal.html
.. _Slot:                           http://pyside.github.io/docs/pyside/PySide/QtCore/Slot.html
.. .. T
.. _QTemporaryFile:                 http://pyside.github.io/docs/pyside/PySide/QtCore/QTemporaryFile.html
.. _QTextBoundaryFinder:            http://pyside.github.io/docs/pyside/PySide/QtCore/QTextBoundaryFinder.html
.. _QTextCodec:                     http://pyside.github.io/docs/pyside/PySide/QtCore/QTextCodec.html
.. _QTextCodec.ConverterState:      http://pyside.github.io/docs/pyside/PySide/QtCore/QTextCodec.ConverterState.html
.. _QTextDecoder:                   http://pyside.github.io/docs/pyside/PySide/QtCore/QTextDecoder.html
.. _QTextEncoder:                   http://pyside.github.io/docs/pyside/PySide/QtCore/QTextEncoder.html
.. _QTextStream:                    http://pyside.github.io/docs/pyside/PySide/QtCore/QTextStream.html
.. _QTextStreamManipulator:         http://pyside.github.io/docs/pyside/PySide/QtCore/QTextStreamManipulator.html
.. _QThread:                        http://pyside.github.io/docs/pyside/PySide/QtCore/QThread.html
.. _QThreadPool:                    http://pyside.github.io/docs/pyside/PySide/QtCore/QThreadPool.html
.. _QTime:                          http://pyside.github.io/docs/pyside/PySide/QtCore/QTime.html
.. _QTimeLine:                      http://pyside.github.io/docs/pyside/PySide/QtCore/QTimeLine.html
.. _QTimer:                         http://pyside.github.io/docs/pyside/PySide/QtCore/QTimer.html
.. _QTimerEvent:                    http://pyside.github.io/docs/pyside/PySide/QtCore/QTimerEvent.html
.. _QTranslator:                    http://pyside.github.io/docs/pyside/PySide/QtCore/QTranslator.html
.. .. U
.. _QUrl:                           http://pyside.github.io/docs/pyside/PySide/QtCore/QUrl.html
.. _QUuid:                          http://pyside.github.io/docs/pyside/PySide/QtCore/QUuid.html
.. .. V
.. _QVariantAnimation:              http://pyside.github.io/docs/pyside/PySide/QtCore/QVariantAnimation.html
.. .. W
.. _QWaitCondition:                 http://pyside.github.io/docs/pyside/PySide/QtCore/QWaitCondition.html
.. _QWriteLocker:                   http://pyside.github.io/docs/pyside/PySide/QtCore/QWriteLocker.html
.. .. X
.. _QXmlStreamAttribute:            http://pyside.github.io/docs/pyside/PySide/QtCore/QXmlStreamAttribute.html
.. _QXmlStreamAttributes:           http://pyside.github.io/docs/pyside/PySide/QtCore/QXmlStreamAttributes.html
.. _QXmlStreamEntityDeclaration:    http://pyside.github.io/docs/pyside/PySide/QtCore/QXmlStreamEntityDeclaration.html
.. _QXmlStreamEntityResolver:       http://pyside.github.io/docs/pyside/PySide/QtCore/QXmlStreamEntityResolver.html
.. _QXmlStreamNamespaceDeclaration: http://pyside.github.io/docs/pyside/PySide/QtCore/QXmlStreamNamespaceDeclaration.html
.. _QXmlStreamNotationDeclaration:  http://pyside.github.io/docs/pyside/PySide/QtCore/QXmlStreamNotationDeclaration.html
.. _QXmlStreamReader:               http://pyside.github.io/docs/pyside/PySide/QtCore/QXmlStreamReader.html
.. _QXmlStreamWriter:               http://pyside.github.io/docs/pyside/PySide/QtCore/QXmlStreamWriter.html
.. .. t
.. _Qt:                             http://pyside.github.io/docs/pyside/PySide/QtCore/Qt.html
.. _QtConcurrent:                   http://pyside.github.io/docs/pyside/PySide/QtCore/QtConcurrent.html


.. .. QtGui
.. .. A
.. _QAbstractButton:                          http://pyside.github.io/docs/pyside/PySide/QtGui/QAbstractButton.html
.. _QAbstractGraphicsShapeItem:               http://pyside.github.io/docs/pyside/PySide/QtGui/QAbstractGraphicsShapeItem.html
.. _QAbstractItemDelegate:                    http://pyside.github.io/docs/pyside/PySide/QtGui/QAbstractItemDelegate.html
.. _QAbstractItemView:                        http://pyside.github.io/docs/pyside/PySide/QtGui/QAbstractItemView.html
.. _QAbstractPageSetupDialog:                 http://pyside.github.io/docs/pyside/PySide/QtGui/QAbstractPageSetupDialog.html
.. _QAbstractPrintDialog:                     http://pyside.github.io/docs/pyside/PySide/QtGui/QAbstractPrintDialog.html
.. _QAbstractProxyModel:                      http://pyside.github.io/docs/pyside/PySide/QtGui/QAbstractProxyModel.html
.. _QAbstractScrollArea:                      http://pyside.github.io/docs/pyside/PySide/QtGui/QAbstractScrollArea.html
.. _QAbstractSlider:                          http://pyside.github.io/docs/pyside/PySide/QtGui/QAbstractSlider.html
.. _QAbstractSpinBox:                         http://pyside.github.io/docs/pyside/PySide/QtGui/QAbstractSpinBox.html
.. _QAbstractTextDocumentLayout:              http://pyside.github.io/docs/pyside/PySide/QtGui/QAbstractTextDocumentLayout.html
.. _QAbstractTextDocumentLayout.PaintContext: http://pyside.github.io/docs/pyside/PySide/QtGui/QAbstractTextDocumentLayout.PaintContext.html
.. _QAbstractTextDocumentLayout.Selection:    http://pyside.github.io/docs/pyside/PySide/QtGui/QAbstractTextDocumentLayout.Selection.html
.. _QAccessibleEvent:                         http://pyside.github.io/docs/pyside/PySide/QtGui/QAccessibleEvent.html
.. _QAction:                                  http://pyside.github.io/docs/pyside/PySide/QtGui/QAction.html
.. _QActionEvent:                             http://pyside.github.io/docs/pyside/PySide/QtGui/QActionEvent.html
.. _QActionGroup:                             http://pyside.github.io/docs/pyside/PySide/QtGui/QActionGroup.html
.. _QApplication:                             http://pyside.github.io/docs/pyside/PySide/QtGui/QApplication.html
.. .. B
.. _QBitmap:                                  http://pyside.github.io/docs/pyside/PySide/QtGui/QBitmap.html
.. _QBoxLayout:                               http://pyside.github.io/docs/pyside/PySide/QtGui/QBoxLayout.html
.. _QBrush:                                   http://pyside.github.io/docs/pyside/PySide/QtGui/QBrush.html
.. _QButtonGroup:                             http://pyside.github.io/docs/pyside/PySide/QtGui/QButtonGroup.html
.. .. C
.. _QCDEStyle:                                http://pyside.github.io/docs/pyside/PySide/QtGui/QCDEStyle.html
.. _QCalendarWidget:                          http://pyside.github.io/docs/pyside/PySide/QtGui/QCalendarWidget.html
.. _QCheckBox:                                http://pyside.github.io/docs/pyside/PySide/QtGui/QCheckBox.html
.. _QCleanlooksStyle:                         http://pyside.github.io/docs/pyside/PySide/QtGui/QCleanlooksStyle.html
.. _QClipboard:                               http://pyside.github.io/docs/pyside/PySide/QtGui/QClipboard.html
.. _QClipboardEvent:                          http://pyside.github.io/docs/pyside/PySide/QtGui/QClipboardEvent.html
.. _QCloseEvent:                              http://pyside.github.io/docs/pyside/PySide/QtGui/QCloseEvent.html
.. _QColor:                                   http://pyside.github.io/docs/pyside/PySide/QtGui/QColor.html
.. _QColorDialog:                             http://pyside.github.io/docs/pyside/PySide/QtGui/QColorDialog.html
.. _QColumnView:                              http://pyside.github.io/docs/pyside/PySide/QtGui/QColumnView.html
.. _QComboBox:                                http://pyside.github.io/docs/pyside/PySide/QtGui/QComboBox.html
.. _QCommandLinkButton:                       http://pyside.github.io/docs/pyside/PySide/QtGui/QCommandLinkButton.html
.. _QCommonStyle:                             http://pyside.github.io/docs/pyside/PySide/QtGui/QCommonStyle.html
.. _QCompleter:                               http://pyside.github.io/docs/pyside/PySide/QtGui/QCompleter.html
.. _QConicalGradient:                         http://pyside.github.io/docs/pyside/PySide/QtGui/QConicalGradient.html
.. _QContextMenuEvent:                        http://pyside.github.io/docs/pyside/PySide/QtGui/QContextMenuEvent.html
.. _QCursor:                                  http://pyside.github.io/docs/pyside/PySide/QtGui/QCursor.html
.. .. D
.. _QDataWidgetMapper:                        http://pyside.github.io/docs/pyside/PySide/QtGui/QDataWidgetMapper.html
.. _QDateEdit:                                http://pyside.github.io/docs/pyside/PySide/QtGui/QDateEdit.html
.. _QDateTimeEdit:                            http://pyside.github.io/docs/pyside/PySide/QtGui/QDateTimeEdit.html
.. _QDesktopServices:                         http://pyside.github.io/docs/pyside/PySide/QtGui/QDesktopServices.html
.. _QDesktopWidget:                           http://pyside.github.io/docs/pyside/PySide/QtGui/QDesktopWidget.html
.. _QDial:                                    http://pyside.github.io/docs/pyside/PySide/QtGui/QDial.html
.. _QDialog:                                  http://pyside.github.io/docs/pyside/PySide/QtGui/QDialog.html
.. _QDialogButtonBox:                         http://pyside.github.io/docs/pyside/PySide/QtGui/QDialogButtonBox.html
.. _QDirModel:                                http://pyside.github.io/docs/pyside/PySide/QtGui/QDirModel.html
.. _QDockWidget:                              http://pyside.github.io/docs/pyside/PySide/QtGui/QDockWidget.html
.. _QDoubleSpinBox:                           http://pyside.github.io/docs/pyside/PySide/QtGui/QDoubleSpinBox.html
.. _QDoubleValidator:                         http://pyside.github.io/docs/pyside/PySide/QtGui/QDoubleValidator.html
.. _QDrag:                                    http://pyside.github.io/docs/pyside/PySide/QtGui/QDrag.html
.. _QDragEnterEvent:                          http://pyside.github.io/docs/pyside/PySide/QtGui/QDragEnterEvent.html
.. _QDragLeaveEvent:                          http://pyside.github.io/docs/pyside/PySide/QtGui/QDragLeaveEvent.html
.. _QDragMoveEvent:                           http://pyside.github.io/docs/pyside/PySide/QtGui/QDragMoveEvent.html
.. _QDropEvent:                               http://pyside.github.io/docs/pyside/PySide/QtGui/QDropEvent.html
.. .. E
.. _QErrorMessage:                            http://pyside.github.io/docs/pyside/PySide/QtGui/QErrorMessage.html
.. .. F
.. _QFileDialog:                              http://pyside.github.io/docs/pyside/PySide/QtGui/QFileDialog.html
.. _QFileIconProvider:                        http://pyside.github.io/docs/pyside/PySide/QtGui/QFileIconProvider.html
.. _QFileOpenEvent:                           http://pyside.github.io/docs/pyside/PySide/QtGui/QFileOpenEvent.html
.. _QFileSystemModel:                         http://pyside.github.io/docs/pyside/PySide/QtGui/QFileSystemModel.html
.. _QFocusEvent:                              http://pyside.github.io/docs/pyside/PySide/QtGui/QFocusEvent.html
.. _QFocusFrame:                              http://pyside.github.io/docs/pyside/PySide/QtGui/QFocusFrame.html
.. _QFont:                                    http://pyside.github.io/docs/pyside/PySide/QtGui/QFont.html
.. _QFontComboBox:                            http://pyside.github.io/docs/pyside/PySide/QtGui/QFontComboBox.html
.. _QFontDatabase:                            http://pyside.github.io/docs/pyside/PySide/QtGui/QFontDatabase.html
.. _QFontDialog:                              http://pyside.github.io/docs/pyside/PySide/QtGui/QFontDialog.html
.. _QFontInfo:                                http://pyside.github.io/docs/pyside/PySide/QtGui/QFontInfo.html
.. _QFontMetrics:                             http://pyside.github.io/docs/pyside/PySide/QtGui/QFontMetrics.html
.. _QFontMetricsF:                            http://pyside.github.io/docs/pyside/PySide/QtGui/QFontMetricsF.html
.. _QFormLayout:                              http://pyside.github.io/docs/pyside/PySide/QtGui/QFormLayout.html
.. _QFrame:                                   http://pyside.github.io/docs/pyside/PySide/QtGui/QFrame.html
.. ..G
.. _QGesture:                                 http://pyside.github.io/docs/pyside/PySide/QtGui/QGesture.html
.. _QGestureEvent:                            http://pyside.github.io/docs/pyside/PySide/QtGui/QGestureEvent.html
.. _QGestureRecognizer:                       http://pyside.github.io/docs/pyside/PySide/QtGui/QGestureRecognizer.html
.. _QGradient:                                http://pyside.github.io/docs/pyside/PySide/QtGui/QGradient.html
.. _QGraphicsAnchor:                          http://pyside.github.io/docs/pyside/PySide/QtGui/QGraphicsAnchor.html
.. _QGraphicsAnchorLayout:                    http://pyside.github.io/docs/pyside/PySide/QtGui/QGraphicsAnchorLayout.html
.. _QGraphicsBlurEffect:                      http://pyside.github.io/docs/pyside/PySide/QtGui/QGraphicsBlurEffect.html
.. _QGraphicsColorizeEffect:                  http://pyside.github.io/docs/pyside/PySide/QtGui/QGraphicsColorizeEffect.html
.. _QGraphicsDropShadowEffect:                http://pyside.github.io/docs/pyside/PySide/QtGui/QGraphicsDropShadowEffect.html
.. _QGraphicsEffect:                          http://pyside.github.io/docs/pyside/PySide/QtGui/QGraphicsEffect.html
.. _QGraphicsEllipseItem:                     http://pyside.github.io/docs/pyside/PySide/QtGui/QGraphicsEllipseItem.html
.. _QGraphicsGridLayout:                      http://pyside.github.io/docs/pyside/PySide/QtGui/QGraphicsGridLayout.html
.. _QGraphicsItem:                            http://pyside.github.io/docs/pyside/PySide/QtGui/QGraphicsItem.html
.. _QGraphicsItemAnimation:                   http://pyside.github.io/docs/pyside/PySide/QtGui/QGraphicsItemAnimation.html
.. _QGraphicsItemGroup:                       http://pyside.github.io/docs/pyside/PySide/QtGui/QGraphicsItemGroup.html
.. _QGraphicsLayout:                          http://pyside.github.io/docs/pyside/PySide/QtGui/QGraphicsLayout.html
.. _QGraphicsLayoutItem:                      http://pyside.github.io/docs/pyside/PySide/QtGui/QGraphicsLayoutItem.html
.. _QGraphicsLineItem:                        http://pyside.github.io/docs/pyside/PySide/QtGui/QGraphicsLineItem.html
.. _QGraphicsLinearLayout:                    http://pyside.github.io/docs/pyside/PySide/QtGui/QGraphicsLinearLayout.html
.. _QGraphicsObject:                          http://pyside.github.io/docs/pyside/PySide/QtGui/QGraphicsObject.html
.. _QGraphicsOpacityEffect:                   http://pyside.github.io/docs/pyside/PySide/QtGui/QGraphicsOpacityEffect.html
.. _QGraphicsPathItem:                        http://pyside.github.io/docs/pyside/PySide/QtGui/QGraphicsPathItem.html
.. _QGraphicsPixmapItem:                      http://pyside.github.io/docs/pyside/PySide/QtGui/QGraphicsPixmapItem.html
.. _QGraphicsPolygonItem:                     http://pyside.github.io/docs/pyside/PySide/QtGui/QGraphicsPolygonItem.html
.. _QGraphicsProxyWidget:                     http://pyside.github.io/docs/pyside/PySide/QtGui/QGraphicsProxyWidget.html
.. _QGraphicsRectItem:                        http://pyside.github.io/docs/pyside/PySide/QtGui/QGraphicsRectItem.html
.. _QGraphicsRotation:                        http://pyside.github.io/docs/pyside/PySide/QtGui/QGraphicsRotation.html
.. _QGraphicsScale:                           http://pyside.github.io/docs/pyside/PySide/QtGui/QGraphicsScale.html
.. _QGraphicsScene:                           http://pyside.github.io/docs/pyside/PySide/QtGui/QGraphicsScene.html
.. _QGraphicsSceneContextMenuEvent:           http://pyside.github.io/docs/pyside/PySide/QtGui/QGraphicsSceneContextMenuEvent.html
.. _QGraphicsSceneDragDropEvent:              http://pyside.github.io/docs/pyside/PySide/QtGui/QGraphicsSceneDragDropEvent.html
.. _QGraphicsSceneEvent:                      http://pyside.github.io/docs/pyside/PySide/QtGui/QGraphicsSceneEvent.html
.. _QGraphicsSceneHelpEvent:                  http://pyside.github.io/docs/pyside/PySide/QtGui/QGraphicsSceneHelpEvent.html
.. _QGraphicsSceneHoverEvent:                 http://pyside.github.io/docs/pyside/PySide/QtGui/QGraphicsSceneHoverEvent.html
.. _QGraphicsSceneMouseEvent:                 http://pyside.github.io/docs/pyside/PySide/QtGui/QGraphicsSceneMouseEvent.html
.. _QGraphicsSceneMoveEvent:                  http://pyside.github.io/docs/pyside/PySide/QtGui/QGraphicsSceneMoveEvent.html
.. _QGraphicsSceneResizeEvent:                http://pyside.github.io/docs/pyside/PySide/QtGui/QGraphicsSceneResizeEvent.html
.. _QGraphicsSceneWheelEvent:                 http://pyside.github.io/docs/pyside/PySide/QtGui/QGraphicsSceneWheelEvent.html
.. _QGraphicsSimpleTextItem:                  http://pyside.github.io/docs/pyside/PySide/QtGui/QGraphicsSimpleTextItem.html
.. _QGraphicsTextItem:                        http://pyside.github.io/docs/pyside/PySide/QtGui/QGraphicsTextItem.html
.. _QGraphicsTransform:                       http://pyside.github.io/docs/pyside/PySide/QtGui/QGraphicsTransform.html
.. _QGraphicsView:                            http://pyside.github.io/docs/pyside/PySide/QtGui/QGraphicsView.html
.. _QGraphicsWidget:                          http://pyside.github.io/docs/pyside/PySide/QtGui/QGraphicsWidget.html
.. _QGridLayout:                              http://pyside.github.io/docs/pyside/PySide/QtGui/QGridLayout.html
.. _QGroupBox:                                http://pyside.github.io/docs/pyside/PySide/QtGui/QGroupBox.html
.. _QGtkStyle:                                http://pyside.github.io/docs/pyside/PySide/QtGui/QGtkStyle.html
.. ..H
.. _QHBoxLayout:                              http://pyside.github.io/docs/pyside/PySide/QtGui/QHBoxLayout.html
.. _QHeaderView:                              http://pyside.github.io/docs/pyside/PySide/QtGui/QHeaderView.html
.. _QHelpEvent:                               http://pyside.github.io/docs/pyside/PySide/QtGui/QHelpEvent.html
.. _QHideEvent:                               http://pyside.github.io/docs/pyside/PySide/QtGui/QHideEvent.html
.. _QHoverEvent:                              http://pyside.github.io/docs/pyside/PySide/QtGui/QHoverEvent.html
.. ..I
.. _QIcon:                                    http://pyside.github.io/docs/pyside/PySide/QtGui/QIcon.html
.. _QIconDragEvent:                           http://pyside.github.io/docs/pyside/PySide/QtGui/QIconDragEvent.html
.. _QIconEngine:                              http://pyside.github.io/docs/pyside/PySide/QtGui/QIconEngine.html
.. _QIconEngineV2:                            http://pyside.github.io/docs/pyside/PySide/QtGui/QIconEngineV2.html
.. _QImage:                                   http://pyside.github.io/docs/pyside/PySide/QtGui/QImage.html
.. _QImageIOHandler:                          http://pyside.github.io/docs/pyside/PySide/QtGui/QImageIOHandler.html
.. _QImageReader:                             http://pyside.github.io/docs/pyside/PySide/QtGui/QImageReader.html
.. _QImageWriter:                             http://pyside.github.io/docs/pyside/PySide/QtGui/QImageWriter.html
.. _QInputContext:                            http://pyside.github.io/docs/pyside/PySide/QtGui/QInputContext.html
.. _QInputContextFactory:                     http://pyside.github.io/docs/pyside/PySide/QtGui/QInputContextFactory.html
.. _QInputDialog:                             http://pyside.github.io/docs/pyside/PySide/QtGui/QInputDialog.html
.. _QInputEvent:                              http://pyside.github.io/docs/pyside/PySide/QtGui/QInputEvent.html
.. _QInputMethodEvent:                        http://pyside.github.io/docs/pyside/PySide/QtGui/QInputMethodEvent.html
.. _QInputMethodEvent.Attribute:              http://pyside.github.io/docs/pyside/PySide/QtGui/QInputMethodEvent.Attribute.html
.. _QIntValidator:                            http://pyside.github.io/docs/pyside/PySide/QtGui/QIntValidator.html
.. _QItemDelegate:                            http://pyside.github.io/docs/pyside/PySide/QtGui/QItemDelegate.html
.. _QItemEditorCreatorBase:                   http://pyside.github.io/docs/pyside/PySide/QtGui/QItemEditorCreatorBase.html
.. _QItemEditorFactory:                       http://pyside.github.io/docs/pyside/PySide/QtGui/QItemEditorFactory.html
.. _QItemSelection:                           http://pyside.github.io/docs/pyside/PySide/QtGui/QItemSelection.html
.. _QItemSelectionModel:                      http://pyside.github.io/docs/pyside/PySide/QtGui/QItemSelectionModel.html
.. _QItemSelectionRange:                      http://pyside.github.io/docs/pyside/PySide/QtGui/QItemSelectionRange.html
.. ..K
.. _QKeyEvent:                                http://pyside.github.io/docs/pyside/PySide/QtGui/QKeyEvent.html
.. _QKeyEventTransition:                      http://pyside.github.io/docs/pyside/PySide/QtGui/QKeyEventTransition.html
.. _QKeySequence:                             http://pyside.github.io/docs/pyside/PySide/QtGui/QKeySequence.html
.. ..L
.. _QLCDNumber:                               http://pyside.github.io/docs/pyside/PySide/QtGui/QLCDNumber.html
.. _QLabel:                                   http://pyside.github.io/docs/pyside/PySide/QtGui/QLabel.html
.. _QLayout:                                  http://pyside.github.io/docs/pyside/PySide/QtGui/QLayout.html
.. _QLayoutItem:                              http://pyside.github.io/docs/pyside/PySide/QtGui/QLayoutItem.html
.. _QLineEdit:                                http://pyside.github.io/docs/pyside/PySide/QtGui/QLineEdit.html
.. _QLinearGradient:                          http://pyside.github.io/docs/pyside/PySide/QtGui/QLinearGradient.html
.. _QListView:                                http://pyside.github.io/docs/pyside/PySide/QtGui/QListView.html
.. _QListWidget:                              http://pyside.github.io/docs/pyside/PySide/QtGui/QListWidget.html
.. _QListWidgetItem:                          http://pyside.github.io/docs/pyside/PySide/QtGui/QListWidgetItem.html
.. ..M
.. _QMainWindow:                              http://pyside.github.io/docs/pyside/PySide/QtGui/QMainWindow.html
.. _QMatrix:                                  http://pyside.github.io/docs/pyside/PySide/QtGui/QMatrix.html
.. _QMatrix2x2:                               http://pyside.github.io/docs/pyside/PySide/QtGui/QMatrix2x2.html
.. _QMatrix2x3:                               http://pyside.github.io/docs/pyside/PySide/QtGui/QMatrix2x3.html
.. _QMatrix2x4:                               http://pyside.github.io/docs/pyside/PySide/QtGui/QMatrix2x4.html
.. _QMatrix3x2:                               http://pyside.github.io/docs/pyside/PySide/QtGui/QMatrix3x2.html
.. _QMatrix3x3:                               http://pyside.github.io/docs/pyside/PySide/QtGui/QMatrix3x3.html
.. _QMatrix3x4:                               http://pyside.github.io/docs/pyside/PySide/QtGui/QMatrix3x4.html
.. _QMatrix4x2:                               http://pyside.github.io/docs/pyside/PySide/QtGui/QMatrix4x2.html
.. _QMatrix4x3:                               http://pyside.github.io/docs/pyside/PySide/QtGui/QMatrix4x3.html
.. _QMatrix4x4:                               http://pyside.github.io/docs/pyside/PySide/QtGui/QMatrix4x4.html
.. _QMdiArea:                                 http://pyside.github.io/docs/pyside/PySide/QtGui/QMdiArea.html
.. _QMdiSubWindow:                            http://pyside.github.io/docs/pyside/PySide/QtGui/QMdiSubWindow.html
.. _QMenu:                                    http://pyside.github.io/docs/pyside/PySide/QtGui/QMenu.html
.. _QMenuBar:                                 http://pyside.github.io/docs/pyside/PySide/QtGui/QMenuBar.html
.. _QMessageBox:                              http://pyside.github.io/docs/pyside/PySide/QtGui/QMessageBox.html
.. _QMotifStyle:                              http://pyside.github.io/docs/pyside/PySide/QtGui/QMotifStyle.html
.. _QMouseEvent:                              http://pyside.github.io/docs/pyside/PySide/QtGui/QMouseEvent.html
.. _QMouseEventTransition:                    http://pyside.github.io/docs/pyside/PySide/QtGui/QMouseEventTransition.html
.. _QMoveEvent:                               http://pyside.github.io/docs/pyside/PySide/QtGui/QMoveEvent.html
.. _QMovie:                                   http://pyside.github.io/docs/pyside/PySide/QtGui/QMovie.html
.. ..P
.. _QPageSetupDialog:                         http://pyside.github.io/docs/pyside/PySide/QtGui/QPageSetupDialog.html
.. _QPaintDevice:                             http://pyside.github.io/docs/pyside/PySide/QtGui/QPaintDevice.html
.. _QPaintEngine:                             http://pyside.github.io/docs/pyside/PySide/QtGui/QPaintEngine.html
.. _QPaintEngineState:                        http://pyside.github.io/docs/pyside/PySide/QtGui/QPaintEngineState.html
.. _QPaintEvent:                              http://pyside.github.io/docs/pyside/PySide/QtGui/QPaintEvent.html
.. _QPainter:                                 http://pyside.github.io/docs/pyside/PySide/QtGui/QPainter.html
.. _QPainter.PixmapFragment:                  http://pyside.github.io/docs/pyside/PySide/QtGui/QPainter.PixmapFragment.html
.. _QPainterPath:                             http://pyside.github.io/docs/pyside/PySide/QtGui/QPainterPath.html
.. _QPainterPath.Element:                     http://pyside.github.io/docs/pyside/PySide/QtGui/QPainterPath.Element.html
.. _QPainterPathStroker:                      http://pyside.github.io/docs/pyside/PySide/QtGui/QPainterPathStroker.html
.. _QPalette:                                 http://pyside.github.io/docs/pyside/PySide/QtGui/QPalette.html
.. _QPanGesture:                              http://pyside.github.io/docs/pyside/PySide/QtGui/QPanGesture.html
.. _QPen:                                     http://pyside.github.io/docs/pyside/PySide/QtGui/QPen.html
.. _QPicture:                                 http://pyside.github.io/docs/pyside/PySide/QtGui/QPicture.html
.. _QPictureIO:                               http://pyside.github.io/docs/pyside/PySide/QtGui/QPictureIO.html
.. _QPinchGesture:                            http://pyside.github.io/docs/pyside/PySide/QtGui/QPinchGesture.html
.. _QPixmap:                                  http://pyside.github.io/docs/pyside/PySide/QtGui/QPixmap.html
.. _QPixmapCache:                             http://pyside.github.io/docs/pyside/PySide/QtGui/QPixmapCache.html
.. _QPixmapCache.Key:                         http://pyside.github.io/docs/pyside/PySide/QtGui/QPixmapCache.Key.html
.. _QPlainTextDocumentLayout:                 http://pyside.github.io/docs/pyside/PySide/QtGui/QPlainTextDocumentLayout.html
.. _QPlainTextEdit:                           http://pyside.github.io/docs/pyside/PySide/QtGui/QPlainTextEdit.html
.. _QPlastiqueStyle:                          http://pyside.github.io/docs/pyside/PySide/QtGui/QPlastiqueStyle.html
.. _QPolygon:                                 http://pyside.github.io/docs/pyside/PySide/QtGui/QPolygon.html
.. _QPolygonF:                                http://pyside.github.io/docs/pyside/PySide/QtGui/QPolygonF.html
.. _QPrintDialog:                             http://pyside.github.io/docs/pyside/PySide/QtGui/QPrintDialog.html
.. _QPrintEngine:                             http://pyside.github.io/docs/pyside/PySide/QtGui/QPrintEngine.html
.. _QPrintPreviewDialog:                      http://pyside.github.io/docs/pyside/PySide/QtGui/QPrintPreviewDialog.html
.. _QPrintPreviewWidget:                      http://pyside.github.io/docs/pyside/PySide/QtGui/QPrintPreviewWidget.html
.. _QPrinter:                                 http://pyside.github.io/docs/pyside/PySide/QtGui/QPrinter.html
.. _QPrinterInfo:                             http://pyside.github.io/docs/pyside/PySide/QtGui/QPrinterInfo.html
.. _QProgressBar:                             http://pyside.github.io/docs/pyside/PySide/QtGui/QProgressBar.html
.. _QProgressDialog:                          http://pyside.github.io/docs/pyside/PySide/QtGui/QProgressDialog.html
.. _QProxyModel:                              http://pyside.github.io/docs/pyside/PySide/QtGui/QProxyModel.html
.. _QPushButton:                              http://pyside.github.io/docs/pyside/PySide/QtGui/QPushButton.html
.. _QPyTextObject:                            http://pyside.github.io/docs/pyside/PySide/QtGui/QPyTextObject.html
.. ..Q
.. _QQuaternion:                              http://pyside.github.io/docs/pyside/PySide/QtGui/QQuaternion.html
.. ..R
.. _QRadialGradient:                          http://pyside.github.io/docs/pyside/PySide/QtGui/QRadialGradient.html
.. _QRadioButton:                             http://pyside.github.io/docs/pyside/PySide/QtGui/QRadioButton.html
.. _QRegExpValidator:                         http://pyside.github.io/docs/pyside/PySide/QtGui/QRegExpValidator.html
.. _QRegion:                                  http://pyside.github.io/docs/pyside/PySide/QtGui/QRegion.html
.. _QResizeEvent:                             http://pyside.github.io/docs/pyside/PySide/QtGui/QResizeEvent.html
.. _QRubberBand:                              http://pyside.github.io/docs/pyside/PySide/QtGui/QRubberBand.html
.. .QtGui..S
.. _QScrollArea:                              http://pyside.github.io/docs/pyside/PySide/QtGui/QScrollArea.html
.. _QScrollBar:                               http://pyside.github.io/docs/pyside/PySide/QtGui/QScrollBar.html
.. _QSessionManager:                          http://pyside.github.io/docs/pyside/PySide/QtGui/QSessionManager.html
.. _QShortcut:                                http://pyside.github.io/docs/pyside/PySide/QtGui/QShortcut.html
.. _QShortcutEvent:                           http://pyside.github.io/docs/pyside/PySide/QtGui/QShortcutEvent.html
.. _QShowEvent:                               http://pyside.github.io/docs/pyside/PySide/QtGui/QShowEvent.html
.. _QSizeGrip:                                http://pyside.github.io/docs/pyside/PySide/QtGui/QSizeGrip.html
.. _QSizePolicy:                              http://pyside.github.io/docs/pyside/PySide/QtGui/QSizePolicy.html
.. _QSlider:                                  http://pyside.github.io/docs/pyside/PySide/QtGui/QSlider.html
.. _QSortFilterProxyModel:                    http://pyside.github.io/docs/pyside/PySide/QtGui/QSortFilterProxyModel.html
.. _QSound:                                   http://pyside.github.io/docs/pyside/PySide/QtGui/QSound.html
.. _QSpacerItem:                              http://pyside.github.io/docs/pyside/PySide/QtGui/QSpacerItem.html
.. _QSpinBox:                                 http://pyside.github.io/docs/pyside/PySide/QtGui/QSpinBox.html
.. _QSplashScreen:                            http://pyside.github.io/docs/pyside/PySide/QtGui/QSplashScreen.html
.. _QSplitter:                                http://pyside.github.io/docs/pyside/PySide/QtGui/QSplitter.html
.. _QSplitterHandle:                          http://pyside.github.io/docs/pyside/PySide/QtGui/QSplitterHandle.html
.. _QStackedLayout:                           http://pyside.github.io/docs/pyside/PySide/QtGui/QStackedLayout.html
.. _QStackedWidget:                           http://pyside.github.io/docs/pyside/PySide/QtGui/QStackedWidget.html
.. _QStandardItem:                            http://pyside.github.io/docs/pyside/PySide/QtGui/QStandardItem.html
.. _QStandardItemModel:                       http://pyside.github.io/docs/pyside/PySide/QtGui/QStandardItemModel.html
.. _QStatusBar:                               http://pyside.github.io/docs/pyside/PySide/QtGui/QStatusBar.html
.. _QStatusTipEvent:                          http://pyside.github.io/docs/pyside/PySide/QtGui/QStatusTipEvent.html
.. _QStringListModel:                         http://pyside.github.io/docs/pyside/PySide/QtGui/QStringListModel.html
.. _QStyle:                                   http://pyside.github.io/docs/pyside/PySide/QtGui/QStyle.html
.. _QStyleFactory:                            http://pyside.github.io/docs/pyside/PySide/QtGui/QStyleFactory.html
.. _QStyleHintReturn:                         http://pyside.github.io/docs/pyside/PySide/QtGui/QStyleHintReturn.html
.. _QStyleHintReturnMask:                     http://pyside.github.io/docs/pyside/PySide/QtGui/QStyleHintReturnMask.html
.. _QStyleHintReturnVariant:                  http://pyside.github.io/docs/pyside/PySide/QtGui/QStyleHintReturnVariant.html
.. _QStyleOption:                             http://pyside.github.io/docs/pyside/PySide/QtGui/QStyleOption.html
.. _QStyleOptionButton:                       http://pyside.github.io/docs/pyside/PySide/QtGui/QStyleOptionButton.html
.. _QStyleOptionComboBox:                     http://pyside.github.io/docs/pyside/PySide/QtGui/QStyleOptionComboBox.html
.. _QStyleOptionComplex:                      http://pyside.github.io/docs/pyside/PySide/QtGui/QStyleOptionComplex.html
.. _QStyleOptionDockWidget:                   http://pyside.github.io/docs/pyside/PySide/QtGui/QStyleOptionDockWidget.html
.. _QStyleOptionDockWidgetV2:                 http://pyside.github.io/docs/pyside/PySide/QtGui/QStyleOptionDockWidgetV2.html
.. _QStyleOptionFocusRect:                    http://pyside.github.io/docs/pyside/PySide/QtGui/QStyleOptionFocusRect.html
.. _QStyleOptionFrame:                        http://pyside.github.io/docs/pyside/PySide/QtGui/QStyleOptionFrame.html
.. _QStyleOptionFrameV2:                      http://pyside.github.io/docs/pyside/PySide/QtGui/QStyleOptionFrameV2.html
.. _QStyleOptionFrameV3:                      http://pyside.github.io/docs/pyside/PySide/QtGui/QStyleOptionFrameV3.html
.. _QStyleOptionGraphicsItem:                 http://pyside.github.io/docs/pyside/PySide/QtGui/QStyleOptionGraphicsItem.html
.. _QStyleOptionGroupBox:                     http://pyside.github.io/docs/pyside/PySide/QtGui/QStyleOptionGroupBox.html
.. _QStyleOptionHeader:                       http://pyside.github.io/docs/pyside/PySide/QtGui/QStyleOptionHeader.html
.. _QStyleOptionMenuItem:                     http://pyside.github.io/docs/pyside/PySide/QtGui/QStyleOptionMenuItem.html
.. _QStyleOptionProgressBar:                  http://pyside.github.io/docs/pyside/PySide/QtGui/QStyleOptionProgressBar.html
.. _QStyleOptionProgressBarV2:                http://pyside.github.io/docs/pyside/PySide/QtGui/QStyleOptionProgressBarV2.html
.. _QStyleOptionRubberBand:                   http://pyside.github.io/docs/pyside/PySide/QtGui/QStyleOptionRubberBand.html
.. _QStyleOptionSizeGrip:                     http://pyside.github.io/docs/pyside/PySide/QtGui/QStyleOptionSizeGrip.html
.. _QStyleOptionSlider:                       http://pyside.github.io/docs/pyside/PySide/QtGui/QStyleOptionSlider.html
.. _QStyleOptionSpinBox:                      http://pyside.github.io/docs/pyside/PySide/QtGui/QStyleOptionSpinBox.html
.. _QStyleOptionTab:                          http://pyside.github.io/docs/pyside/PySide/QtGui/QStyleOptionTab.html
.. _QStyleOptionTabBarBase:                   http://pyside.github.io/docs/pyside/PySide/QtGui/QStyleOptionTabBarBase.html
.. _QStyleOptionTabBarBaseV2:                 http://pyside.github.io/docs/pyside/PySide/QtGui/QStyleOptionTabBarBaseV2.html
.. _QStyleOptionTabV2:                        http://pyside.github.io/docs/pyside/PySide/QtGui/QStyleOptionTabV2.html
.. _QStyleOptionTabV3:                        http://pyside.github.io/docs/pyside/PySide/QtGui/QStyleOptionTabV3.html
.. _QStyleOptionTabWidgetFrame:               http://pyside.github.io/docs/pyside/PySide/QtGui/QStyleOptionTabWidgetFrame.html
.. _QStyleOptionTitleBar:                     http://pyside.github.io/docs/pyside/PySide/QtGui/QStyleOptionTitleBar.html
.. _QStyleOptionToolBar:                      http://pyside.github.io/docs/pyside/PySide/QtGui/QStyleOptionToolBar.html
.. _QStyleOptionToolBox:                      http://pyside.github.io/docs/pyside/PySide/QtGui/QStyleOptionToolBox.html
.. _QStyleOptionToolBoxV2:                    http://pyside.github.io/docs/pyside/PySide/QtGui/QStyleOptionToolBoxV2.html
.. _QStyleOptionToolButton:                   http://pyside.github.io/docs/pyside/PySide/QtGui/QStyleOptionToolButton.html
.. _QStyleOptionViewItem:                     http://pyside.github.io/docs/pyside/PySide/QtGui/QStyleOptionViewItem.html
.. _QStyleOptionViewItemV2:                   http://pyside.github.io/docs/pyside/PySide/QtGui/QStyleOptionViewItemV2.html
.. _QStyleOptionViewItemV3:                   http://pyside.github.io/docs/pyside/PySide/QtGui/QStyleOptionViewItemV3.html
.. _QStyleOptionViewItemV4:                   http://pyside.github.io/docs/pyside/PySide/QtGui/QStyleOptionViewItemV4.html
.. _QStylePainter:                            http://pyside.github.io/docs/pyside/PySide/QtGui/QStylePainter.html
.. _QStyledItemDelegate:                      http://pyside.github.io/docs/pyside/PySide/QtGui/QStyledItemDelegate.html
.. _QSwipeGesture:                            http://pyside.github.io/docs/pyside/PySide/QtGui/QSwipeGesture.html
.. _QSyntaxHighlighter:                       http://pyside.github.io/docs/pyside/PySide/QtGui/QSyntaxHighlighter.html
.. _QSystemTrayIcon:                          http://pyside.github.io/docs/pyside/PySide/QtGui/QSystemTrayIcon.html
.. ..T
.. _QTabBar:                                  http://pyside.github.io/docs/pyside/PySide/QtGui/QTabBar.html
.. _QTabWidget:                               http://pyside.github.io/docs/pyside/PySide/QtGui/QTabWidget.html
.. _QTableView:                               http://pyside.github.io/docs/pyside/PySide/QtGui/QTableView.html
.. _QTableWidget:                             http://pyside.github.io/docs/pyside/PySide/QtGui/QTableWidget.html
.. _QTableWidgetItem:                         http://pyside.github.io/docs/pyside/PySide/QtGui/QTableWidgetItem.html
.. _QTableWidgetSelectionRange:               http://pyside.github.io/docs/pyside/PySide/QtGui/QTableWidgetSelectionRange.html
.. _QTabletEvent:                             http://pyside.github.io/docs/pyside/PySide/QtGui/QTabletEvent.html
.. _QTapAndHoldGesture:                       http://pyside.github.io/docs/pyside/PySide/QtGui/QTapAndHoldGesture.html
.. _QTapGesture:                              http://pyside.github.io/docs/pyside/PySide/QtGui/QTapGesture.html
.. _QTextBlock:                               http://pyside.github.io/docs/pyside/PySide/QtGui/QTextBlock.html
.. _QTextBlock.iterator:                      http://pyside.github.io/docs/pyside/PySide/QtGui/QTextBlock.iterator.html
.. _QTextBlockFormat:                         http://pyside.github.io/docs/pyside/PySide/QtGui/QTextBlockFormat.html
.. _QTextBlockGroup:                          http://pyside.github.io/docs/pyside/PySide/QtGui/QTextBlockGroup.html
.. _QTextBlockUserData:                       http://pyside.github.io/docs/pyside/PySide/QtGui/QTextBlockUserData.html
.. _QTextBrowser:                             http://pyside.github.io/docs/pyside/PySide/QtGui/QTextBrowser.html
.. _QTextCharFormat:                          http://pyside.github.io/docs/pyside/PySide/QtGui/QTextCharFormat.html
.. _QTextCursor:                              http://pyside.github.io/docs/pyside/PySide/QtGui/QTextCursor.html
.. _QTextDocument:                            http://pyside.github.io/docs/pyside/PySide/QtGui/QTextDocument.html
.. _QTextDocumentFragment:                    http://pyside.github.io/docs/pyside/PySide/QtGui/QTextDocumentFragment.html
.. _QTextEdit:                                http://pyside.github.io/docs/pyside/PySide/QtGui/QTextEdit.html
.. _QTextEdit.ExtraSelection:                 http://pyside.github.io/docs/pyside/PySide/QtGui/QTextEdit.ExtraSelection.html
.. _QTextFormat:                              http://pyside.github.io/docs/pyside/PySide/QtGui/QTextFormat.html
.. _QTextFragment:                            http://pyside.github.io/docs/pyside/PySide/QtGui/QTextFragment.html
.. _QTextFrame:                               http://pyside.github.io/docs/pyside/PySide/QtGui/QTextFrame.html
.. _QTextFrame.iterator:                      http://pyside.github.io/docs/pyside/PySide/QtGui/QTextFrame.iterator.html
.. _QTextFrameFormat:                         http://pyside.github.io/docs/pyside/PySide/QtGui/QTextFrameFormat.html
.. _QTextImageFormat:                         http://pyside.github.io/docs/pyside/PySide/QtGui/QTextImageFormat.html
.. _QTextInlineObject:                        http://pyside.github.io/docs/pyside/PySide/QtGui/QTextInlineObject.html
.. _QTextItem:                                http://pyside.github.io/docs/pyside/PySide/QtGui/QTextItem.html
.. _QTextLayout:                              http://pyside.github.io/docs/pyside/PySide/QtGui/QTextLayout.html
.. _QTextLayout.FormatRange:                  http://pyside.github.io/docs/pyside/PySide/QtGui/QTextLayout.FormatRange.html
.. _QTextLength:                              http://pyside.github.io/docs/pyside/PySide/QtGui/QTextLength.html
.. _QTextLine:                                http://pyside.github.io/docs/pyside/PySide/QtGui/QTextLine.html
.. _QTextList:                                http://pyside.github.io/docs/pyside/PySide/QtGui/QTextList.html
.. _QTextListFormat:                          http://pyside.github.io/docs/pyside/PySide/QtGui/QTextListFormat.html
.. _QTextObject:                              http://pyside.github.io/docs/pyside/PySide/QtGui/QTextObject.html
.. _QTextObjectInterface:                     http://pyside.github.io/docs/pyside/PySide/QtGui/QTextObjectInterface.html
.. _QTextOption:                              http://pyside.github.io/docs/pyside/PySide/QtGui/QTextOption.html
.. _QTextOption.Tab:                          http://pyside.github.io/docs/pyside/PySide/QtGui/QTextOption.Tab.html
.. _QTextTable:                               http://pyside.github.io/docs/pyside/PySide/QtGui/QTextTable.html
.. _QTextTableCell:                           http://pyside.github.io/docs/pyside/PySide/QtGui/QTextTableCell.html
.. _QTextTableCellFormat:                     http://pyside.github.io/docs/pyside/PySide/QtGui/QTextTableCellFormat.html
.. _QTextTableFormat:                         http://pyside.github.io/docs/pyside/PySide/QtGui/QTextTableFormat.html
.. _QTileRules:                               http://pyside.github.io/docs/pyside/PySide/QtGui/QTileRules.html
.. _QTimeEdit:                                http://pyside.github.io/docs/pyside/PySide/QtGui/QTimeEdit.html
.. _QToolBar:                                 http://pyside.github.io/docs/pyside/PySide/QtGui/QToolBar.html
.. _QToolBarChangeEvent:                      http://pyside.github.io/docs/pyside/PySide/QtGui/QToolBarChangeEvent.html
.. _QToolBox:                                 http://pyside.github.io/docs/pyside/PySide/QtGui/QToolBox.html
.. _QToolButton:                              http://pyside.github.io/docs/pyside/PySide/QtGui/QToolButton.html
.. _QToolTip:                                 http://pyside.github.io/docs/pyside/PySide/QtGui/QToolTip.html
.. _QTouchEvent:                              http://pyside.github.io/docs/pyside/PySide/QtGui/QTouchEvent.html
.. _QTouchEvent.TouchPoint:                   http://pyside.github.io/docs/pyside/PySide/QtGui/QTouchEvent.TouchPoint.html
.. _QTransform:                               http://pyside.github.io/docs/pyside/PySide/QtGui/QTransform.html
.. _QTreeView:                                http://pyside.github.io/docs/pyside/PySide/QtGui/QTreeView.html
.. _QTreeWidget:                              http://pyside.github.io/docs/pyside/PySide/QtGui/QTreeWidget.html
.. _QTreeWidgetItem:                          http://pyside.github.io/docs/pyside/PySide/QtGui/QTreeWidgetItem.html
.. _QTreeWidgetItemIterator:                  http://pyside.github.io/docs/pyside/PySide/QtGui/QTreeWidgetItemIterator.html
.. ..U
.. _QUndoCommand:                             http://pyside.github.io/docs/pyside/PySide/QtGui/QUndoCommand.html
.. _QUndoGroup:                               http://pyside.github.io/docs/pyside/PySide/QtGui/QUndoGroup.html
.. _QUndoStack:                               http://pyside.github.io/docs/pyside/PySide/QtGui/QUndoStack.html
.. _QUndoView:                                http://pyside.github.io/docs/pyside/PySide/QtGui/QUndoView.html
.. ..V
.. _QVBoxLayout:                              http://pyside.github.io/docs/pyside/PySide/QtGui/QVBoxLayout.html
.. _QValidator:                               http://pyside.github.io/docs/pyside/PySide/QtGui/QValidator.html
.. _QVector2D:                                http://pyside.github.io/docs/pyside/PySide/QtGui/QVector2D.html
.. _QVector3D:                                http://pyside.github.io/docs/pyside/PySide/QtGui/QVector3D.html
.. _QVector4D:                                http://pyside.github.io/docs/pyside/PySide/QtGui/QVector4D.html
.. .. W
.. _QWhatsThis:                               http://pyside.github.io/docs/pyside/PySide/QtGui/QWhatsThis.html
.. _QWhatsThisClickedEvent:                   http://pyside.github.io/docs/pyside/PySide/QtGui/QWhatsThisClickedEvent.html
.. _QWheelEvent:                              http://pyside.github.io/docs/pyside/PySide/QtGui/QWheelEvent.html
.. _QWidget:                                  http://pyside.github.io/docs/pyside/PySide/QtGui/QWidget.html
.. _QWidgetAction:                            http://pyside.github.io/docs/pyside/PySide/QtGui/QWidgetAction.html
.. _QWidgetItem:                              http://pyside.github.io/docs/pyside/PySide/QtGui/QWidgetItem.html
.. _QWindowStateChangeEvent:                  http://pyside.github.io/docs/pyside/PySide/QtGui/QWindowStateChangeEvent.html
.. _QWindowsStyle:                            http://pyside.github.io/docs/pyside/PySide/QtGui/QWindowsStyle.html
.. _QWizard:                                  http://pyside.github.io/docs/pyside/PySide/QtGui/QWizard.html
.. _QWizardPage:                              http://pyside.github.io/docs/pyside/PySide/QtGui/QWizardPage.html
.. _QWorkspace:                               http://pyside.github.io/docs/pyside/PySide/QtGui/QWorkspace.html
.. .. X
.. _QX11EmbedContainer:                       http://pyside.github.io/docs/pyside/PySide/QtGui/QX11EmbedContainer.html
.. _QX11EmbedWidget:                          http://pyside.github.io/docs/pyside/PySide/QtGui/QX11EmbedWidget.html
.. _QX11Info:                                 http://pyside.github.io/docs/pyside/PySide/QtGui/QX11Info.html


.. .. wxPython Phoenix


.. _wx.ActivateEvent:            http://wxpython.org/Phoenix/docs/html/ActivateEvent.html
.. _wx.BookCtrlEvent:            http://wxpython.org/Phoenix/docs/html/BookCtrlEvent.html
.. _wx.CalculateLayoutEvent:     http://wxpython.org/Phoenix/docs/html/CalculateLayoutEvent.html
.. _wx.ChildFocusEvent:          http://wxpython.org/Phoenix/docs/html/ChildFocusEvent.html
.. _wx.ChoicebookEvent:          http://wxpython.org/Phoenix/docs/html/ChoicebookEvent.html
.. _wx.ClipboardEvent:           http://wxpython.org/Phoenix/docs/html/ClipboardEvent.html
.. _wx.ClipboardTextEvent:       http://wxpython.org/Phoenix/docs/html/ClipboardTextEvent.html
.. _wx.CloseEvent:               http://wxpython.org/Phoenix/docs/html/CloseEvent.html
.. _wx.CollapsiblePaneEvent:     http://wxpython.org/Phoenix/docs/html/CollapsiblePaneEvent.html
.. _wx.ColourPickerEvent:        http://wxpython.org/Phoenix/docs/html/ColourPickerEvent.html
.. _wx.CommandEvent:             http://wxpython.org/Phoenix/docs/html/CommandEvent.html
.. _wx.ContextMenuEvent:         http://wxpython.org/Phoenix/docs/html/ContextMenuEvent.html
.. _wx.DateEvent:                http://wxpython.org/Phoenix/docs/html/DateEvent.html
.. _wx.DisplayChangedEvent:      http://wxpython.org/Phoenix/docs/html/DisplayChangedEvent.html
.. _wx.DropFilesEvent:           http://wxpython.org/Phoenix/docs/html/DropFilesEvent.html
.. _wx.EraseEvent:               http://wxpython.org/Phoenix/docs/html/EraseEvent.html
.. _wx.Event:                    http://wxpython.org/Phoenix/docs/html/Event.html
.. _wx.FileCtrlEvent:            http://wxpython.org/Phoenix/docs/html/FileCtrlEvent.html
.. _wx.FileDirPickerEvent:       http://wxpython.org/Phoenix/docs/html/FileDirPickerEvent.html
.. _wx.FindDialogEvent:          http://wxpython.org/Phoenix/docs/html/FindDialogEvent.html
.. _wx.FocusEvent:               http://wxpython.org/Phoenix/docs/html/FocusEvent.html
.. _wx.FontPickerEvent:          http://wxpython.org/Phoenix/docs/html/FontPickerEvent.html
.. _wx.HelpEvent:                http://wxpython.org/Phoenix/docs/html/HelpEvent.html
.. _wx.HyperlinkEvent:           http://wxpython.org/Phoenix/docs/html/HyperlinkEvent.html
.. _wx.IconizeEvent:             http://wxpython.org/Phoenix/docs/html/IconizeEvent.html
.. _wx.IdleEvent:                http://wxpython.org/Phoenix/docs/html/IdleEvent.html
.. _wx.InitDialogEvent:          http://wxpython.org/Phoenix/docs/html/InitDialogEvent.html
.. _wx.JoystickEvent:            http://wxpython.org/Phoenix/docs/html/JoystickEvent.html
.. _wx.KeyEvent:                 http://wxpython.org/Phoenix/docs/html/KeyEvent.html
.. _wx.ListEvent:                http://wxpython.org/Phoenix/docs/html/ListEvent.html
.. _wx.ListbookEvent:            http://wxpython.org/Phoenix/docs/html/ListbookEvent.html
.. _wx.MaximizeEvent:            http://wxpython.org/Phoenix/docs/html/MaximizeEvent.html
.. _wx.MenuEvent:                http://wxpython.org/Phoenix/docs/html/MenuEvent.html
.. _wx.MouseCaptureChangedEvent: http://wxpython.org/Phoenix/docs/html/MouseCaptureChangedEvent.html
.. _wx.MouseCaptureLostEvent:    http://wxpython.org/Phoenix/docs/html/MouseCaptureLostEvent.html
.. _wx.MouseEvent:               http://wxpython.org/Phoenix/docs/html/MouseEvent.html
.. _wx.MoveEvent:                http://wxpython.org/Phoenix/docs/html/MoveEvent.html
.. _wx.NavigationKeyEvent:       http://wxpython.org/Phoenix/docs/html/NavigationKeyEvent.html
.. _wx.NcPaintEvent:             http://wxpython.org/Phoenix/docs/html/NcPaintEvent.html
.. _wx.NotebookEvent:            http://wxpython.org/Phoenix/docs/html/NotebookEvent.html
.. _wx.NotifyEvent:              http://wxpython.org/Phoenix/docs/html/NotifyEvent.html
.. _wx.PaintEvent:               http://wxpython.org/Phoenix/docs/html/PaintEvent.html
.. _wx.PaletteChangedEvent:      http://wxpython.org/Phoenix/docs/html/PaletteChangedEvent.html
.. _wx.PostEvent:                http://wxpython.org/Phoenix/docs/html/PostEvent.html
.. _wx.PowerEvent:               http://wxpython.org/Phoenix/docs/html/PowerEvent.html
.. _wx.ProcessEvent:             http://wxpython.org/Phoenix/docs/html/ProcessEvent.html
.. _wx.PyCommandEvent:           http://wxpython.org/Phoenix/docs/html/PyCommandEvent.html
.. _wx.PyEvent:                  http://wxpython.org/Phoenix/docs/html/PyEvent.html
.. _wx.QueryLayoutInfoEvent:     http://wxpython.org/Phoenix/docs/html/QueryLayoutInfoEvent.html
.. _wx.QueryNewPaletteEvent:     http://wxpython.org/Phoenix/docs/html/QueryNewPaletteEvent.html
.. _wx.SashEvent:                http://wxpython.org/Phoenix/docs/html/SashEvent.html
.. _wx.ScrollEvent:              http://wxpython.org/Phoenix/docs/html/ScrollEvent.html
.. _wx.ScrollWinEvent:           http://wxpython.org/Phoenix/docs/html/ScrollWinEvent.html
.. _wx.SetCursorEvent:           http://wxpython.org/Phoenix/docs/html/SetCursorEvent.html
.. _wx.ShowEvent:                http://wxpython.org/Phoenix/docs/html/ShowEvent.html
.. _wx.SizeEvent:                http://wxpython.org/Phoenix/docs/html/SizeEvent.html
.. _wx.SpinDoubleEvent:          http://wxpython.org/Phoenix/docs/html/SpinDoubleEvent.html
.. _wx.SpinEvent:                http://wxpython.org/Phoenix/docs/html/SpinEvent.html
.. _wx.SplitterEvent:            http://wxpython.org/Phoenix/docs/html/SplitterEvent.html
.. _wx.SysColourChangedEvent:    http://wxpython.org/Phoenix/docs/html/SysColourChangedEvent.html
.. _wx.TaskBarIconEvent:         http://wxpython.org/Phoenix/docs/html/TaskBarIconEvent.html
.. _wx.TextUrlEvent:             http://wxpython.org/Phoenix/docs/html/TextUrlEvent.html
.. _wx.ThreadEvent:              http://wxpython.org/Phoenix/docs/html/ThreadEvent.html
.. _wx.TimerEvent:               http://wxpython.org/Phoenix/docs/html/TimerEvent.html
.. _wx.ToolbookEvent:            http://wxpython.org/Phoenix/docs/html/ToolbookEvent.html
.. _wx.TreeEvent:                http://wxpython.org/Phoenix/docs/html/TreeEvent.html
.. _wx.TreebookEvent:            http://wxpython.org/Phoenix/docs/html/TreebookEvent.html
.. _wx.UpdateUIEvent:            http://wxpython.org/Phoenix/docs/html/UpdateUIEvent.html
.. _wx.WindowCreateEvent:        http://wxpython.org/Phoenix/docs/html/WindowCreateEvent.html
.. _wx.WindowDestroyEvent:       http://wxpython.org/Phoenix/docs/html/WindowDestroyEvent.html
.. _wx.WindowModalDialogEvent:   http://wxpython.org/Phoenix/docs/html/WindowModalDialogEvent.html

